#include "protocol.h"
#include <string.h>

// ── CRC-8 / SMBUS (poly=0x07) 256-byte 룩업 테이블 ──────────────────────────
// RPi 측 C++ 코드와 동일한 테이블 — 이기종 간 CRC 호환 보장
// 검증 벡터: crc8({0x31..0x39}, 9) == 0xF4
static const uint8_t crc8_table[256] = {
    0x00, 0x07, 0x0E, 0x09, 0x1C, 0x1B, 0x12, 0x15,
    0x38, 0x3F, 0x36, 0x31, 0x24, 0x23, 0x2A, 0x2D,
    0x70, 0x77, 0x7E, 0x79, 0x6C, 0x6B, 0x62, 0x65,
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    0xE6, 0xE1, 0xE8, 0xEF, 0xFA, 0xFD, 0xF4, 0xF3,
};

uint8_t proto_crc8(const uint8_t *data, size_t len) {
    uint8_t crc = 0x00;
    for (size_t i = 0; i < len; i++) {
        crc = crc8_table[crc ^ data[i]];
    }
    return crc;
}

// ── 프레임 빌더 ───────────────────────────────────────────────────────────────
// raw: [LEN][PAYLOAD...][CRC8] → DLE 스터핑 → [STX][...][ETX]
size_t proto_build_frame(const uint8_t *payload, uint8_t len,
                         uint8_t *frame_out, size_t frame_buf_size) {
    if (len > PROTO_MAX_PAYLOAD) return 0;
    if (frame_buf_size < PROTO_MAX_FRAME) return 0;

    // raw_buf: [LEN][PAYLOAD...][CRC8]
    uint8_t raw_buf[PROTO_MAX_PAYLOAD + 2];
    raw_buf[0] = len;
    if (len > 0) {
        memcpy(&raw_buf[1], payload, len);
    }
    raw_buf[1 + len] = proto_crc8(raw_buf, 1 + len);  // CRC over [LEN]+[PAYLOAD]

    const size_t raw_len = (size_t)(2 + len);

    size_t pos = 0;
    frame_out[pos++] = PROTO_STX;

    for (size_t i = 0; i < raw_len; i++) {
        uint8_t b = raw_buf[i];
        if (b == PROTO_STX || b == PROTO_ETX || b == PROTO_DLE) {
            frame_out[pos++] = PROTO_DLE;
            frame_out[pos++] = b ^ PROTO_DLE_XOR;
        } else {
            frame_out[pos++] = b;
        }
    }

    frame_out[pos++] = PROTO_ETX;
    return pos;
}

// ── FSM 파서 ──────────────────────────────────────────────────────────────────
void proto_parser_reset(ProtoParser *p) {
    p->state   = PARSE_WAIT_STX;
    p->raw_pos = 0;
}

bool proto_parser_feed(ProtoParser *p, uint8_t byte,
                       uint8_t *payload_out, uint8_t *payload_len_out) {
    switch (p->state) {

    case PARSE_WAIT_STX:
        if (byte == PROTO_STX) {
            p->raw_pos = 0;
            p->state   = PARSE_RAW_RECV;
        }
        return false;

    case PARSE_RAW_RECV:
        if (byte == PROTO_STX) {
            // 프레임 중간 STX → 재동기화
            p->raw_pos = 0;
            return false;
        }
        if (byte == PROTO_DLE) {
            p->state = PARSE_DLE_RECV;
            return false;
        }
        if (byte == PROTO_ETX) {
            // 프레임 종료 검증
            p->state = PARSE_WAIT_STX;

            if (p->raw_pos < 2) return false;

            const uint8_t declared_len = p->raw[0];
            if (p->raw_pos != (size_t)(declared_len + 2)) return false;
            if (declared_len > PROTO_MAX_PAYLOAD) return false;

            const uint8_t expected_crc = proto_crc8(p->raw, 1 + declared_len);
            if (p->raw[1 + declared_len] != expected_crc) {
                Serial.printf("[proto] CRC 불일치: expected=0x%02X got=0x%02X\n",
                              expected_crc, p->raw[1 + declared_len]);
                return false;
            }

            memcpy(payload_out, &p->raw[1], declared_len);
            *payload_len_out = declared_len;
            return true;
        }
        // 일반 데이터
        if (p->raw_pos >= sizeof(p->raw)) {
            proto_parser_reset(p);
            return false;
        }
        p->raw[p->raw_pos++] = byte;
        return false;

    case PARSE_DLE_RECV:
        if (p->raw_pos >= sizeof(p->raw)) {
            proto_parser_reset(p);
            return false;
        }
        p->raw[p->raw_pos++] = byte ^ PROTO_DLE_XOR;
        p->state = PARSE_RAW_RECV;
        return false;
    }
    return false;
}
